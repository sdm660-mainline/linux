// SPDX-License-Identifier: GPL-2.0-only
/*
 * Copyright (c) 2026, Paul Sajna <hello@paulsajna.com>
 */

/dts-v1/;

#include "sdm660-bbry-athena-common.dtsi"

/ {
	compatible = "bbry,athena-syna", "qcom,sdm660";
};

&panel {
	compatible = "syna,td4310";
};

&synaptics_touchscreen {
	status = "okay";
};

