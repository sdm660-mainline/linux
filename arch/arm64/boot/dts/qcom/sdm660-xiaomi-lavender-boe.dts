// SPDX-License-Identifier: GPL-2.0-only
/*
 * Copyright (c) 2024, Barnabas Czeman <trabarni@gmail.com>
 */

/dts-v1/;

#include "sdm660-xiaomi-lavender-common.dtsi"

/ {
	model = "Xiaomi Redmi Note 7 (Boe)";
	compatible = "xiaomi,lavender-boe", "qcom,sdm660";
};

&blsp_i2c1 {
	status = "okay";

};

&panel {
	compatible = "boe,td4320";
	iovcc-supply = <&vreg_l11a_1p8>;
};

&synaptics_ts {
	status = "okay";
};
