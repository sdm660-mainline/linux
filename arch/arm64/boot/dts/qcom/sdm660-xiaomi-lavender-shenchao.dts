// SPDX-License-Identifier: GPL-2.0-only
/*
 * Copyright (c) 2024, Barnabas Czeman <trabarni@gmail.com>
 */

/dts-v1/;

#include "sdm660-xiaomi-lavender-common.dtsi"

/ {
	model = "Xiaomi Redmi Note 7 (Shenchao)";
	compatible = "xiaomi,lavender-shenchao", "qcom,sdm660";
};

&novatek_ts {
	status = "okay";
};

&panel {
	compatible = "shenchao,fhdplus-video", "novatek,nt36672a";
	vddio-supply = <&vreg_l11a_1p8>;
	vddneg-supply = <&lcdb_fixed>;
	vddpos-supply = <&lcdb_fixed>;
};
