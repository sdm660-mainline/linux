// SPDX-License-Identifier: GPL-2.0-only
/*
 * Copyright (c) 2025, Paul Sajna <hello@paulsajna.com>
 */

/dts-v1/;

#include "sdm636-bbry-luna-common.dtsi"

/ {
	compatible = "bbry,luna-boe", "qcom,sdm636";
};

&panel {
	compatible = "boe,bv045fhm-l00";
};
