// SPDX-License-Identifier: GPL-2.0-only
/*
 * Copyright (c) 2024, Barnabas Czeman <trabarni@gmail.com>
 */

/dts-v1/;

#include "sdm660-xiaomi-lavender-common.dtsi"

/ {
	model = "Xiaomi Redmi Note 7 (Tianma)";
	compatible = "xiaomi,lavender-tianma", "qcom,sdm660";
};

&novatek_ts {
	status = "okay";
};

&panel {
	compatible = "tianma,tl063fvmca01-00", "novatek,nt36672a";
	vddio-supply = <&vreg_l11a_1p8>;
	vddneg-supply = <&lcdb_fixed>;
	vddpos-supply = <&lcdb_fixed>;
};
