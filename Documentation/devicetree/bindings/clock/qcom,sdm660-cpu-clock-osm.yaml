## Documentation/devicetree/bindings/power/supply/qcom,smb1351.yaml
```yaml
# SPDX-License-Identifier: (GPL-2.0-only OR BSD-2-Clause)
%YAML 1.2
---
$id: http://devicetree.org/schemas/power/supply/qcom,smb1351.yaml#
$schema: http://devicetree.org/meta-schemas/core.yaml#

title: Qualcomm SMB1351 battery charger

maintainers:
  - Adrian Nguyen <thenguyen1024@gmail.com>

description:
  The Qualcomm SMB1351 is a switch-mode single-cell battery charger with an
  I2C interface. Some boards use it as a parallel charger next to the
  charger in a PMIC, taking power from the same USB input and charging the
  same battery. On some of them it is powered from that input only, so it
  does not respond on I2C and loses its configuration while the input is
  absent. The SMB1350 has the same programming interface, and the two can be
  told apart by their version register.

allOf:
  - $ref: power-supply.yaml#

properties:
  compatible:
    oneOf:
      - const: qcom,smb1351
      - items:
          - const: qcom,smb1350
          - const: qcom,smb1351

  reg:
    maxItems: 1

  interrupts:
    description:
      The STAT output, which the chip can drive as an interrupt line.
    maxItems: 1

  power-supplies:
    description:
      The PMIC charger whose USB input (VBUS) also powers this charger, on
      boards that use it as a parallel charger.
    maxItems: 1

required:
  - compatible
  - reg
  - monitored-battery

unevaluatedProperties: false

examples:
  - |
    #include <dt-bindings/interrupt-controller/irq.h>

    i2c {
        #address-cells = <1>;
        #size-cells = <0>;

        charger@1d {
            compatible = "qcom,smb1350", "qcom,smb1351";
            reg = <0x1d>;
            interrupts = <61 IRQ_TYPE_LEVEL_LOW>;

            monitored-battery = <&battery>;
            power-supplies = <&pm660_charger>;
        };
    };
```

## Documentation/devicetree/bindings/regulator/qcom-lcdb-regulator.yaml
```yaml
# SPDX-License-Identifier: GPL-2.0-only OR BSD-2-Clause
%YAML 1.2
---
$id: http://devicetree.org/schemas/regulator/qcom-lcdb-regulator.yaml#
$schema: http://devicetree.org/meta-schemas/core.yaml#

title: Qualcomm's LCDB (LCD Bias) Regulator

maintainers:
  - Alexey Minnekhanov <alexeymin@minlexx.ru>

description:
  LCDB module provides voltage bias to the LCD display panel. The biases
  are positive (supported by LDO) and negative (supported by NCP) voltage
  signals. Currently implemented for PM660L PMIC.

properties:
  compatible:
    enum:
      - qcom,pm660l-lcdb

  reg:
    maxItems: 1
  
  interrupts:
    description:
      Short-circuit interrupt, common for both LDO and NCP.

  interrupt-names:
    items:
      - const: sc-irq

  ldo:
    type: object
    $ref: regulator.yaml#
    unevaluatedProperties: false

  ncp:
    type: object
    $ref: regulator.yaml#
    unevaluatedProperties: false

required:
  - compatible
  - reg
  - interrupts
  - interrupt-names

additionalProperties: false

examples:
  - |
    #include <dt-bindings/interrupt-controller/irq.h>
    #include <dt-bindings/spmi/spmi.h>

    pmic@3 {
      compatible = "qcom,pm660l", "qcom,spmi-pmic";
      reg = <0x3 SPMI_USID>;
      #address-cells = <1>;
      #size-cells = <0>;
      regulator@ec00 {
        compatible = "qcom,pm660l-lcdb";
        reg = <0xec00>;
        interrupts = <0x3 0xec 0x1 IRQ_TYPE_EDGE_RISING>;
        interrupt-names = "sc-irq";

        ldo {
          regulator-name = "lcdb_ldo";
          regulator-min-microvolt = <4000000>;
          regulator-max-microvolt = <6000000>;
        };

        ncp {
          regulator-name = "lcdb_ncp";
          regulator-min-microvolt = <4000000>;
          regulator-max-microvolt = <6000000>;
        };
      };
    };

...
```

## Documentation/devicetree/bindings/sound/ti,tas2557.yaml
```yaml
# SPDX-License-Identifier: (GPL-2.0-only OR BSD-2-Clause)
# Copyright (C) 2026 Gianluca Boiano <morf3089@gmail.com>
%YAML 1.2
---
$id: http://devicetree.org/schemas/sound/ti,tas2557.yaml#
$schema: http://devicetree.org/meta-schemas/core.yaml#

title: Texas Instruments TAS2557 Mono Smart Amplifier

maintainers:
  - Gianluca Boiano <morf3089@gmail.com>

description: |
  The TAS2557 is a mono, digital-input Class-D amplifier with an
  integrated DSP for speaker protection. Audio is carried over I2S/TDM
  (ASI). The on-chip DSP boots from a firmware image that is generated
  for a specific speaker design using the TI PurePath Console tuning
  tools.

  Stereo playback is built from two devices, each reproducing one audio
  slot selected through the ti,channel property and applying the
  matching per-device tuning contained in a stereo-tuned firmware
  image.

  Datasheet: https://www.ti.com/lit/gpn/tas2557

allOf:
  - $ref: dai-common.yaml#

properties:
  compatible:
    const: ti,tas2557

  reg:
    maxItems: 1

  '#sound-dai-cells':
    const: 0

  reset-gpios:
    maxItems: 1
    description: GPIO connected to the active-low RESET pin.

  interrupts:
    maxItems: 1
    description: Fault interrupt output (INT).

  vbat-supply:
    description: Battery/boost input supply (VBAT), 2.9 V to 5.5 V.

  iovdd-supply:
    description: Digital I/O supply, 1.62 V to 3.6 V.

  avdd-supply:
    description: Analog supply, 1.65 V to 1.95 V.

  dvdd-supply:
    description: Digital core supply, 1.65 V to 1.95 V.

  ti,imon-slot-no:
    $ref: /schemas/types.yaml#/definitions/uint32
    description: TDM TX time slot for current-sense data.
    default: 0
    minimum: 0
    maximum: 7

  ti,vmon-slot-no:
    $ref: /schemas/types.yaml#/definitions/uint32
    description: TDM TX time slot for voltage-sense data.
    default: 2
    minimum: 0
    maximum: 7

  ti,channel:
    $ref: /schemas/types.yaml#/definitions/uint32
    description: |
      Audio slot of the stereo stream reproduced by this device (0 =
      left, 1 = right). With stereo firmware this also selects which
      per-device tuning set is applied.
    enum: [0, 1]
    default: 0

  firmware-name:
    $ref: /schemas/types.yaml#/definitions/string
    description: |
      Name of the DSP firmware image to load. Defaults to a name
      derived from the silicon revision. Stereo systems typically use
      a stereo-tuned image shared by both devices.

required:
  - compatible
  - reg
  - '#sound-dai-cells'

unevaluatedProperties: false

examples:
  - |
    #include <dt-bindings/gpio/gpio.h>
    #include <dt-bindings/interrupt-controller/irq.h>

    i2c {
        #address-cells = <1>;
        #size-cells = <0>;

        audio-codec@4c {
            compatible = "ti,tas2557";
            reg = <0x4c>;
            #sound-dai-cells = <0>;
            reset-gpios = <&tlmm 77 GPIO_ACTIVE_LOW>;
            interrupt-parent = <&tlmm>;
            interrupts = <73 IRQ_TYPE_LEVEL_HIGH>;

            vbat-supply = <&vph_pwr>;
            iovdd-supply = <&vreg_l6b_1p8>;
            avdd-supply = <&vreg_l6b_1p8>;
            dvdd-supply = <&vreg_l6b_1p8>;

            ti,imon-slot-no = <0>;
            ti,vmon-slot-no = <2>;
            ti,channel = <0>;
        };
    };
```

## Documentation/devicetree/bindings/usb/qcom,pmic-typec-gen1.yaml
```yaml
# SPDX-License-Identifier: (GPL-2.0-only OR BSD-2-Clause)
%YAML 1.2
---
$id: http://devicetree.org/schemas/usb/qcom,pmic-typec-gen1.yaml#
$schema: http://devicetree.org/meta-schemas/core.yaml#

title: Qualcomm PMIC USB Type-C block (gen1)

maintainers:
  - David Heidelberg <david@ixit.cz>

description:
  First generation of the Qualcomm PMIC Type-C port controller.

properties:
  compatible:
    enum:
      - qcom,pm660-typec
      - qcom,pmi8998-typec

  reg:
    items:
      - description: USBIN peripheral base (Type-C CC logic)
      - description: USB PD PHY peripheral base

  interrupts:
    items:
      - description: Type-C change - CC state, tCCDebounce done, VBUS change or error
      - description: Power Domain Signal TX - HardReset or CableReset signal TX
      - description: Power Domain Signal RX - HardReset or CableReset signal RX
      - description: Power Domain TX complete
      - description: Power Domain RX complete
      - description: Power Domain TX fail
      - description: Power Domain TX message discard
      - description: Power Domain RX message discard
      - description: Power Domain Fast Role Swap event

  interrupt-names:
    items:
      - const: type-c-change
      - const: sig-tx
      - const: sig-rx
      - const: msg-tx
      - const: msg-rx
      - const: msg-tx-failed
      - const: msg-tx-discarded
      - const: msg-rx-discarded
      - const: fr-swap

  vdd-pdphy-supply:
    description: VDD regulator supply to the PDPHY.

  connector:
    type: object
    $ref: /schemas/connector/usb-connector.yaml#
    unevaluatedProperties: false

required:
  - compatible
  - reg
  - interrupts
  - interrupt-names
  - vdd-pdphy-supply
  - connector

additionalProperties: false

examples:
  - |
    #include <dt-bindings/interrupt-controller/irq.h>
    #include <dt-bindings/usb/pd.h>

    pmic {
        #address-cells = <1>;
        #size-cells = <0>;

        typec@1300 {
            compatible = "qcom,pmi8998-typec";
            reg = <0x1300>,
                  <0x1700>;

            interrupts = <0x2 0x13 0x7 IRQ_TYPE_EDGE_RISING>,
                         <0x2 0x17 0x0 IRQ_TYPE_EDGE_RISING>,
                         <0x2 0x17 0x1 IRQ_TYPE_EDGE_RISING>,
                         <0x2 0x17 0x2 IRQ_TYPE_EDGE_RISING>,
                         <0x2 0x17 0x3 IRQ_TYPE_EDGE_RISING>,
                         <0x2 0x17 0x4 IRQ_TYPE_EDGE_RISING>,
                         <0x2 0x17 0x5 IRQ_TYPE_EDGE_RISING>,
                         <0x2 0x17 0x6 IRQ_TYPE_EDGE_RISING>,
                         <0x2 0x17 0x7 IRQ_TYPE_EDGE_RISING>;
            interrupt-names = "type-c-change",
                              "sig-tx",
                              "sig-rx",
                              "msg-tx",
                              "msg-rx",
                              "msg-tx-failed",
                              "msg-tx-discarded",
                              "msg-rx-discarded",
                              "fr-swap";

            vdd-pdphy-supply = <&vreg_l24a_3p075>;

            connector {
                compatible = "usb-c-connector";

                power-role = "dual";
                data-role = "dual";
                try-power-role = "sink";

                source-pdos = <PDO_FIXED(5000, 900, PDO_FIXED_DUAL_ROLE |
                               PDO_FIXED_USB_COMM | PDO_FIXED_DATA_SWAP)>;
                sink-pdos = <PDO_FIXED(5000, 3000, PDO_FIXED_DUAL_ROLE |
                             PDO_FIXED_USB_COMM | PDO_FIXED_DATA_SWAP)>;
                op-sink-microwatt = <15000000>;

                ports {
                    #address-cells = <1>;
                    #size-cells = <0>;

                    port@0 {
                        reg = <0>;
                        endpoint {
                            remote-endpoint = <&usb_dwc3_hs>;
                        };
                    };
                };
            };
        };
    };
...
```
