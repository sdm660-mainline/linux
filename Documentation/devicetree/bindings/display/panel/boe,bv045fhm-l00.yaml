## Documentation/devicetree/bindings/display/panel/boe,bv045fhm-l00.yaml
```yaml
# SPDX-License-Identifier: GPL-2.0-only OR BSD-2-Clause
%YAML 1.2
---
$id: http://devicetree.org/schemas/display/panel/boe,bv045fhm-l00.yaml#
$schema: http://devicetree.org/meta-schemas/core.yaml#

title: BOE BV045FHM-L00 LCD DSI Panel

maintainers:
  - Paul Sajna <hello@paulsajna.com>

allOf:
  - $ref: panel-common.yaml#

properties:
  compatible:
    enum:
      - boe,bv045fhm-l00

  reg:
    maxItems: 1

  reset-gpios:
    description: specifies a GPIO used for the reset pin

  backlight:
    description: phandle of the backlight device attached to the panel

  port: true
  rotation: true
  width-mm: true
  height-mm: true

required:
  - compatible
  - reg
  - reset-gpios

unevalueatedProperties: false

examples:
  - |
    #address-cells = <1>;
    #size-cells = <0>;

    vdd-supply = <&vreg_l1b_0p925>;
    vdda-supply = <&vreg_l1a_1p225>;

    panel: panel@0 {
      compatible = "boe,bv045fhm-l00";
      reg = <0>;

      backlight = <&pm660l_wled>;
      reset-gpios = <&tlmm 53 GPIO_ACTIVE_LOW>;

      pinctrl-0 = <&mdss_dsi_active &mdss_te_active>;
      pinctrl-1 = <&mdss_dsi_sleep &mdss_te_sleep>;
      pinctrl-names = "default", "sleep";

      width-mm = <63>;
      height-mm = <95>;

      port {
        panel_in: endpoint {
          remote-endpoint = <&mdss_dsi0_out>;
        };
      };
    };
...
```

## Documentation/devicetree/bindings/display/panel/novatek,nt51021.yaml
```yaml
# SPDX-License-Identifier: GPL-2.0-only OR BSD-2-Clause
%YAML 1.2
---
$id: http://devicetree.org/schemas/display/panel/novatek,nt51021.yaml#
$schema: http://devicetree.org/meta-schemas/core.yaml#

title: Novatek NT51021 based DSI display Panels

maintainers:
  - Nickolay Goppen <setotau@mainlining.org>

description: |
  The nt51021 IC from Novatek is a generic DSI Panel IC used to drive dsi
  panels.
  Right now, support is added only for a BOE WUXGA LCD display panels with a
  resolution of 1200x1920. They are video mode DSI panels.

allOf:
  - $ref: panel-common.yaml#

properties:
  compatible:
    items:
      - enum:
          - boe,tv101wum-nx0
          - boe,tv080wum-nx2
      - const: novatek,nt51021
    description: This indicates the panel manufacturer of the panel that is
      in turn using the NT51021 panel driver. This compatible string
      determines how the NT51021 panel driver is configured for the indicated
      panel. The novatek,nt51021 compatible shall always be provided as a fallback.

  reg:
    maxItems: 1

  reset-gpios:
    maxItems: 1
    description: phandle of gpio for reset line - This should be 8mA, gpio
      can be configured using mux, pinctrl, pinctrl-names (active high)

  avdd-supply:
    description: phandle of the regulator that provides the supply voltage
      for analog circuits

  port: true
  backlight: true

required:
  - compatible
  - reg
  - avdd-supply
  - reset-gpios
  - port

unevaluatedProperties: false

examples:
  - |+
    #include <dt-bindings/gpio/gpio.h>

    dsi0 {
        #address-cells = <1>;
        #size-cells = <0>;

        panel@0 {
            compatible = "boe,tv101wum-nx0", "novatek,nt51021";
            reg = <0>;
            avdd-supply = <&lcd_pwr>;

            backlight = <&i2c_backlight>;
            reset-gpios = <&tlmm 62 GPIO_ACTIVE_LOW>;

            port {
                panel_in: endpoint {
                    remote-endpoint = <&dsi0_out>;
                };
            };
        };
    };

...
```

## Documentation/devicetree/bindings/display/panel/tianma,td4310.yaml
```yaml
# SPDX-License-Identifier: (GPL-2.0-only OR BSD-2-Clause)
%YAML 1.2
---
$id: http://devicetree.org/schemas/display/panel/tianma,td4310.yaml#
$schema: http://devicetree.org/meta-schemas/core.yaml#

title: Tianma TD4310 DSI Display Panel

maintainers:
  - Alexey Minnekhanov <alexeymin@postmarketos.org>

allOf:
  - $ref: panel-common.yaml#

properties:
  compatible:
    enum:
      - tianma,td4310-xiaomi-whyred

  reg:
    maxItems: 1

  reset-gpios:
    description: specifies a GPIO used for the rest pin

  backlight:
    description: phandle of the backlight device attached to the panel

  vddio-supply:
    description: phandle of the regulator that provides the supply for IO lines

  vsp-supply:
    description: phandle of the positive boost supply regulator

  vsn-supply:
    description: phandle of the negative boost supply regulator

  port: true
  rotation: true
  width-mm: true
  height-mm: true

required:
  - compatible
  - reg
  - reset-gpios
  - vddio-supply

unevaluatedProperties: false

examples:
  - |
    #include <dt-bindings/gpio/gpio.h>
    dsi {
        #address-cells = <1>;
        #size-cells = <0>;
        panel@0 {
            compatible = "tianma,td4310-xiaomi-whyred";
            reg = <0>;
            reset-gpios = <&tlmm 53 GPIO_ACTIVE_LOW>;
            vddio-supply = <&vreg_l11a_1p8>;
            backlight = <&pm660l_wled>;
            port {
                panel_in: endpoint {
                    remote-endpoint = <&mdss_dsi0_out>;
                };
            };
        };
    };

...
```

## Documentation/devicetree/bindings/power/supply/qcom,pmi8998-fg.yaml
```yaml
# SPDX-License-Identifier: (GPL-2.0-only or BSD-3-Clause)
%YAML 1.2
---
$id: http://devicetree.org/schemas/power/supply/qcom,pmi8998-fg.yaml#
$schema: http://devicetree.org/meta-schemas/core.yaml#

title: Qualcomm PMI8998 PMIC Fuel Gauge

maintainers:
  - Caleb Connolly <caleb@connolly.tech>
  - Joel Selvaraj <jo@jsfamily.in>
  - Yassine Oudjana <y.oudjana@protonmail.com>

allOf:
  - $ref: power-supply.yaml#

properties:
  compatible:
    enum:
      - qcom,pmi8998-fg

  reg:
    maxItems: 1

  interrupts:
    items:
      - description: State of charge change interrupt

  interrupt-names:
    items:
      - const: soc-delta

  monitored-battery: true

  power-supplies: true

required:
  - compatible
  - reg
  - monitored-battery
  - interrupts
  - interrupt-names

additionalProperties: false

examples:
  - |
    #include <dt-bindings/interrupt-controller/irq.h>

    battery: battery {
      compatible = "simple-battery";

      charge-full-design-microamp-hours = <4070000>;
      voltage-min-design-microvolt = <3400000>;
      voltage-max-design-microvolt = <4400000>;
    };

    pmic {
      #address-cells = <1>;
      #size-cells = <0>;

      fuel-gauge@4000 {
        compatible = "qcom,pmi8998-fg";
        reg = <0x4000>;

        interrupts = <0x2 0x40 0x4 IRQ_TYPE_EDGE_RISING>;
        interrupt-names = "soc-delta";

        monitored-battery = <&battery>;
      };
    };
```
