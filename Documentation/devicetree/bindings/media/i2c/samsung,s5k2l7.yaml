## Documentation/devicetree/bindings/media/i2c/samsung,s5k2l7.yaml
```yaml
# SPDX-License-Identifier: (GPL-2.0-only OR BSD-2-Clause)
%YAML 1.2
---
$id: http://devicetree.org/schemas/media/i2c/samsung,s5k2l7.yaml#
$schema: http://devicetree.org/meta-schemas/core.yaml#

title: Samsung S5K2L7 12MP CMOS image sensor

maintainers:
  - Kulesha Evgeniy <voovdop@gmail.com>

description: |
  The S5K2L7 is a 12 megapixel (4032x3024) RAW10 CMOS image sensor with a
  MIPI CSI-2 (D-PHY, 4 lanes) interface, controlled over I2C.

allOf:
  - $ref: /schemas/media/video-interface-devices.yaml#

properties:
  compatible:
    const: samsung,s5k2l7

  reg:
    maxItems: 1

  clocks:
    description: MCLK supply clock.
    maxItems: 1

  reset-gpios:
    description: Active low GPIO connected to the RESET pad of the sensor.
    maxItems: 1

  dovdd-supply:
    description: Digital I/O supply (1.8 V).

  dvdd-supply:
    description: Digital core supply (1.2 V).

  avdd-supply:
    description: Analog supply (2.8 V).

  port:
    $ref: /schemas/graph.yaml#/$defs/port-base
    additionalProperties: false

    properties:
      endpoint:
        $ref: /schemas/media/video-interfaces.yaml#
        unevaluatedProperties: false

        properties:
          data-lanes:
            items:
              - const: 1
              - const: 2
              - const: 3
              - const: 4

          link-frequencies:
            maxItems: 1

        required:
          - data-lanes
          - link-frequencies

    required:
      - endpoint

required:
  - compatible
  - reg
  - clocks
  - reset-gpios
  - dovdd-supply
  - dvdd-supply
  - avdd-supply
  - port

unevaluatedProperties: false

examples:
  - |
    #include <dt-bindings/gpio/gpio.h>

    i2c {
        #address-cells = <1>;
        #size-cells = <0>;

        camera@10 {
            compatible = "samsung,s5k2l7";
            reg = <0x10>;

            clocks = <&cam_clk>;
            reset-gpios = <&tlmm 48 GPIO_ACTIVE_LOW>;

            dovdd-supply = <&vreg_dovdd>;
            dvdd-supply = <&vreg_dvdd>;
            avdd-supply = <&vreg_avdd>;

            port {
                endpoint {
                    data-lanes = <1 2 3 4>;
                    link-frequencies = /bits/ 64 <666000000>;
                    remote-endpoint = <&camss_csi0_in>;
                };
            };
        };
    };
...
```

## Documentation/devicetree/bindings/media/i2c/samsung,s5k5e8.yaml
```yaml
# SPDX-License-Identifier: (GPL-2.0-only OR BSD-2-Clause)
%YAML 1.2
---
$id: http://devicetree.org/schemas/media/i2c/samsung,s5k5e8.yaml#
$schema: http://devicetree.org/meta-schemas/core.yaml#

title: Samsung S5K5E8 5MP CMOS image sensor

maintainers:
  - Kulesha Evgeniy <voovdop@gmail.com>

description: |
  The S5K5E8 is a 5 megapixel (2592x1944) RAW10 CMOS image sensor with a
  MIPI CSI-2 (D-PHY, 2 lanes) interface, controlled over I2C.

allOf:
  - $ref: /schemas/media/video-interface-devices.yaml#

properties:
  compatible:
    const: samsung,s5k5e8

  reg:
    maxItems: 1

  clocks:
    description: MCLK supply clock.
    maxItems: 1

  reset-gpios:
    description: Active low GPIO connected to the RESET pad of the sensor.
    maxItems: 1

  dovdd-supply:
    description: Digital I/O supply (1.8 V).

  dvdd-supply:
    description: Digital core supply (1.2 V).

  avdd-supply:
    description: Analog supply (2.8 V).

  port:
    $ref: /schemas/graph.yaml#/$defs/port-base
    additionalProperties: false

    properties:
      endpoint:
        $ref: /schemas/media/video-interfaces.yaml#
        unevaluatedProperties: false

        properties:
          data-lanes:
            items:
              - const: 1
              - const: 2

          link-frequencies:
            minItems: 1
            maxItems: 2

        required:
          - data-lanes
          - link-frequencies

    required:
      - endpoint

required:
  - compatible
  - reg
  - clocks
  - reset-gpios
  - dovdd-supply
  - dvdd-supply
  - avdd-supply
  - port

unevaluatedProperties: false

examples:
  - |
    #include <dt-bindings/gpio/gpio.h>

    i2c {
        #address-cells = <1>;
        #size-cells = <0>;

        camera@2d {
            compatible = "samsung,s5k5e8";
            reg = <0x2d>;

            clocks = <&cam_clk>;
            reset-gpios = <&tlmm 52 GPIO_ACTIVE_LOW>;

            dovdd-supply = <&vreg_dovdd>;
            dvdd-supply = <&vreg_dvdd>;
            avdd-supply = <&vreg_avdd>;

            port {
                endpoint {
                    data-lanes = <1 2>;
                    link-frequencies = /bits/ 64 <418000000 300000000>;
                    remote-endpoint = <&camss_csi1_in>;
                };
            };
        };
    };
...
```

## Documentation/devicetree/bindings/media/i2c/sony,imx376.yaml
```yaml
# SPDX-License-Identifier: (GPL-2.0-only OR BSD-2-Clause)
%YAML 1.2
---
$id: http://devicetree.org/schemas/media/i2c/sony,imx376.yaml#
$schema: http://devicetree.org/meta-schemas/core.yaml#

title: Sony IMX376 and IMX486 Image Sensors

maintainers:
  - Gianluca Boiano <morf3089@gmail.com>

description:
  IMX376 (20 MP, 5184x3880) and IMX486 (12 MP, 4032x3016) are Sony CMOS
  Bayer image sensors controlled over I2C (CCI) and sending image data over
  a 4-lane MIPI CSI-2 interface.

allOf:
  - $ref: /schemas/media/video-interface-devices.yaml#
  - if:
      properties:
        compatible:
          contains:
            const: sony,imx376
    then:
      properties:
        port:
          properties:
            endpoint:
              properties:
                link-frequencies:
                  items:
                    - const: 500000000
  - if:
      properties:
        compatible:
          contains:
            const: sony,imx486
    then:
      properties:
        port:
          properties:
            endpoint:
              properties:
                link-frequencies:
                  items:
                    - const: 492000000
                    - const: 252000000

properties:
  compatible:
    enum:
      - sony,imx376
      - sony,imx486

  reg:
    maxItems: 1

  clocks:
    description:
      Input clock (INCK). The driver only supports a 24 MHz input clock and
      uses the rate the clock is running at, so the clock must be configured
      to 24 MHz, e.g. with assigned-clock-rates.
    maxItems: 1

  clock-frequency:
    description:
      Frequency of the input clock in Hz. Optional, the driver reads the rate
      from the clock itself; if present it must match the 24 MHz that the
      sensor PLL settings are calculated for.
    const: 24000000

  vana-supply:
    description: Analog power supply (2.8 V).

  vcore-supply:
    description: Digital core power supply (1.2 V or 1.35 V).

  vio-supply:
    description: Interface power supply (1.8 V).

  reset-gpios:
    description: GPIO connected to the XCLR pin.
    maxItems: 1

  port:
    $ref: /schemas/graph.yaml#/$defs/port-base
    additionalProperties: false

    properties:
      endpoint:
        $ref: /schemas/media/video-interfaces.yaml#
        unevaluatedProperties: false

        properties:
          data-lanes:
            items:
              - const: 1
              - const: 2
              - const: 3
              - const: 4

          link-frequencies: true

        required:
          - data-lanes
          - link-frequencies

required:
  - compatible
  - reg
  - clocks
  - port

unevaluatedProperties: false

examples:
  - |
    #include <dt-bindings/gpio/gpio.h>

    i2c {
        #address-cells = <1>;
        #size-cells = <0>;

        camera@10 {
            compatible = "sony,imx486";
            reg = <0x10>;

            clocks = <&cam_mclk>;
            clock-frequency = <24000000>;
            reset-gpios = <&tlmm 52 GPIO_ACTIVE_LOW>;

            vana-supply = <&cam_avdd>;
            vcore-supply = <&cam_dvdd>;
            vio-supply = <&cam_vio>;

            orientation = <1>;
            rotation = <90>;

            port {
                endpoint {
                    data-lanes = <1 2 3 4>;
                    link-frequencies = /bits/ 64 <492000000 252000000>;
                    remote-endpoint = <&csiphy_ep>;
                };
            };
        };
    };
...
```

## Documentation/devicetree/bindings/sound/ti,tas2557.yaml
```yaml
# SPDX-License-Identifier: (GPL-2.0-only OR BSD-2-Clause)
# Copyright (C) 2026 Gianluca Boiano <morf3089@gmail.com>
%YAML 1.2
---
$id: http://devicetree.org/schemas/sound/ti,tas2557.yaml#
$schema: http://devicetree.org/meta-schemas/core.yaml#

title: Texas Instruments TAS2557 Mono Smart Amplifier

maintainers:
  - Gianluca Boiano <morf3089@gmail.com>

description: |
  The TAS2557 is a mono, digital-input Class-D amplifier with an
  integrated DSP for speaker protection, controlled over I2C, with
  audio over I2S/TDM (ASI). The DSP runs a firmware image generated for
  the speaker with the TI PurePath Console tuning tools.

  One node describes one device or a pair sharing one ASI bus, using
  the reg-array convention of ti,tas2781.yaml. The device at reg index 0
  is DEV_A and the one at index 1 is DEV_B; they select the two halves
  of a stereo-tuned firmware image. The firmware format defines no
  other device types, so a node has at most two devices.

  Datasheet: https://www.ti.com/lit/gpn/tas2557

allOf:
  - $ref: dai-common.yaml#

properties:
  compatible:
    const: ti,tas2557

  reg:
    minItems: 1
    maxItems: 2
    description:
      I2C address of each physical device sharing this node. One
      entry configures a single mono TAS2557. Two entries configure a
      device pair; the device at index 0 is DEV_A and the device at
      index 1 is DEV_B.

  '#sound-dai-cells':
    const: 0

  reset-gpios:
    minItems: 1
    maxItems: 2
    description:
      GPIO connected to the active-low RESET pin of each physical
      device sharing this node, one entry per reg entry. A single
      entry is shared by every device in the group.

  interrupts:
    minItems: 1
    maxItems: 2
    description:
      Fault interrupt output (INT) of each physical device sharing
      this node, one entry per reg entry. A single entry is shared
      by every device in the group.

  vbat-supply:
    description: Battery/boost input supply (VBAT), 2.9 V to 5.5 V.

  iovdd-supply:
    description: Digital I/O supply, 1.62 V to 3.6 V.

  avdd-supply:
    description: Analog supply, 1.65 V to 1.95 V.

  dvdd-supply:
    description: Digital core supply, 1.65 V to 1.95 V.

  firmware-name:
    maxItems: 1
    description:
      Name of the DSP firmware image to load. Defaults to a name
      derived from the silicon revision, which is the mono image, so a
      device pair must set this property. A device pair shares one
      image; each device's half of it is selected by its reg index,
      not by this property.

  ti,asi-port:
    $ref: /schemas/types.yaml#/definitions/uint32
    enum: [1, 2]
    default: 2
    description:
      Which audio serial interface (ASI1 or ASI2) of the chip is
      wired to the host. Only the selected interface is configured.

required:
  - compatible
  - reg
  - '#sound-dai-cells'
  - vbat-supply
  - iovdd-supply
  - avdd-supply
  - dvdd-supply

if:
  properties:
    reg:
      minItems: 2
then:
  required:
    - firmware-name

unevaluatedProperties: false

examples:
  - |
    #include <dt-bindings/gpio/gpio.h>
    #include <dt-bindings/interrupt-controller/irq.h>

    i2c {
        #address-cells = <1>;
        #size-cells = <0>;

        audio-codec@4c {
            compatible = "ti,tas2557";
            reg = <0x4c>;
            #sound-dai-cells = <0>;
            reset-gpios = <&tlmm 77 GPIO_ACTIVE_LOW>;
            interrupt-parent = <&tlmm>;
            interrupts = <73 IRQ_TYPE_LEVEL_HIGH>;

            vbat-supply = <&vph_pwr>;
            iovdd-supply = <&vreg_l6b_1p8>;
            avdd-supply = <&vreg_l6b_1p8>;
            dvdd-supply = <&vreg_l6b_1p8>;
        };
    };
  - |
    #include <dt-bindings/gpio/gpio.h>
    #include <dt-bindings/interrupt-controller/irq.h>

    i2c {
        #address-cells = <1>;
        #size-cells = <0>;

        audio-codec@4c {
            compatible = "ti,tas2557";
            reg = <0x4c>, <0x4e>;
            #sound-dai-cells = <0>;
            reset-gpios = <&tlmm 77 GPIO_ACTIVE_LOW>,
                          <&tlmm 78 GPIO_ACTIVE_LOW>;
            interrupt-parent = <&tlmm>;
            interrupts = <73 IRQ_TYPE_LEVEL_HIGH>, <74 IRQ_TYPE_LEVEL_HIGH>;

            vbat-supply = <&vph_pwr>;
            iovdd-supply = <&vreg_l6b_1p8>;
            avdd-supply = <&vreg_l6b_1p8>;
            dvdd-supply = <&vreg_l6b_1p8>;

            firmware-name = "tas2557-stereo.bin";
        };
    };
...
```
